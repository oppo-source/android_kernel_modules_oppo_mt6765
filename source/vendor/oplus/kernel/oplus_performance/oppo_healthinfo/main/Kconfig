## source/vendor/oplus/kernel/oplus_performance/oppo_healthinfo/main/Kconfig
```kconfig
#ifdef OPLUS_FEATURE_HEALTHINFO
config OPPO_HEALTHINFO
bool "config oppo healthinfo"
help
    define this config to init oppo healthinfo.
config CAMERA_OPT
	bool "config camera opt"
	default n
	help
	  reduce camera provider task runnable time
config MMAP_LOCK_OPT
	bool "config mmap lock opt boos"
	default n
	help
	  reduce sleep time in mmap lock
config OPLUS_FEATURE_AUDIO_OPT
	bool "config audio opt"
	default n
	help
		audio task schedule opt
#endif /* OPLUS_FEATURE_HEALTHINFO */
```

## source/vendor/oplus/kernel/touchscreen/oppo_touchscreen/Himax/Kconfig
```kconfig
source "drivers/input/touchscreen/oppo_touchscreen/Himax/hx83102d_noflash/Kconfig"
```

## source/vendor/oplus/kernel_4.19/audio/Kconfig
```kconfig
#
# oplus extend audio codec configuration
#

config SIA_PA_ALGO
	bool "Use SIA PA ALGO"
	default n

config SND_SOC_AW87339
	bool "Use AW87339 As PA"
	default n

config HSKEY_BLOCK
	bool "Block hskey for 1s"
	default n

config SND_SOC_AW87359
    tristate "SoC Audio for awinic AW87359 Smart K PA"
    depends on I2C
    help
      This option enables support for AW87359 Smart K PA

config SND_SOC_AW87XXX
	tristate "SoC Audio for awinic AW87XXX Smart K PA"
	depends on I2C
	help
	This option enables support for AW87XXX Smart K PA.
```
